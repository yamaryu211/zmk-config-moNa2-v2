#include "mona2.dtsi"

&kscan0 {
        col-gpios
            = <&xiao_d 10 GPIO_ACTIVE_HIGH>
            , <&xiao_d 9 GPIO_ACTIVE_HIGH> 
            , <&xiao_d 8 GPIO_ACTIVE_HIGH> 
            , <&xiao_d 7 GPIO_ACTIVE_HIGH> 
            , <&gpio0 10 GPIO_ACTIVE_HIGH>
            , <&gpio0 9 GPIO_ACTIVE_HIGH>
            ;
};

&left_encoder {
    status = "okay";
};

// 左側でエラーが出るため、無効化設定を追加
&trackball_central_listener {
    status = "disabled";
};