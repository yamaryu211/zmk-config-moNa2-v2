## config/west.yml
```yaml
manifest:
  remotes:
    - name: zmkfirmware
      url-base: https://github.com/zmkfirmware
    - name: yamaryu211
      url-base: https://github.com/yamaryu211
    - name: badjeff # <-- PMW3610
      url-base: https://github.com/badjeff
    # - name: sekigon-gonnoc  # <-- PAW3222
    #   url-base: https://github.com/sekigon-gonnoc
    - name: caksoylar # <-- RGB LED
      url-base: https://github.com/caksoylar
    - name: zettaface # <-- Input Processor Keybind
      url-base: https://github.com/zettaface
    - name: kot149 # <-- ジェスチャーモジュール
      url-base: https://github.com/kot149
  projects:
    - name: zmk
      remote: zmkfirmware
      revision: v0.3.0
      import: app/west.yml
    - name: zmk-pmw3610-driver
      remote: badjeff
      revision: main
    - name: zmk-rgbled-widget
      remote: caksoylar
      revision: main
    - name: zmk-input-processor-keybind
      remote: zettaface
      revision: main
    - name: zmk-mouse-gesture
      remote: kot149
      revision: v1
  self:
    path: config
```
